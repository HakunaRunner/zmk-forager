## boards/shields/forager/Kconfig.defconfig
```kconfig
# ----------------------------
# DONGLE
# ----------------------------
if SHIELD_FORAGER_DONGLE

config ZMK_KEYBOARD_NAME
    default "Forager"

config ZMK_SPLIT_ROLE_CENTRAL
    default y

config ZMK_STUDIO
    default y

config ZMK_SPLIT_BLE_CENTRAL_PERIPHERALS
    default 2

config BT_MAX_CONN
    default 6

config BT_MAX_PAIRED
    default 6

endif


# ----------------------------
# SPLIT ENABLED FOR ALL HALVES
# ----------------------------
if SHIELD_FORAGER_LEFT || SHIELD_FORAGER_RIGHT || SHIELD_FORAGER_DONGLE

config ZMK_SPLIT
    default y

endif
```
